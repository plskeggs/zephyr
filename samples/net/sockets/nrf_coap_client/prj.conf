## CMakeLists.txt
```
#
# Copyright (c) 2019 Nordic Semiconductor
#
# SPDX-License-Identifier: LicenseRef-Nordic-5-Clause
#

cmake_minimum_required(VERSION 3.20.0)

find_package(Zephyr REQUIRED HINTS $ENV{ZEPHYR_BASE})
project(nrf-coap-client)

# NORDIC SDK APP START
target_sources(app PRIVATE src/main.c)
target_sources_ifdef(CONFIG_COAP_DTLS app PRIVATE src/dtls.c)
# NORDIC SDK APP END
```

## Kconfig
```
#
# Copyright (c) 2019 Nordic Semiconductor ASA
#
# SPDX-License-Identifier: LicenseRef-Nordic-5-Clause
#

menu "nRF CoAP client sample"

config COAP_GET_RESOURCE
	string "CoAP GET resource - defaults to Californium observable resource"
	default "obs"

config COAP_PUT_RESOURCE
	string "CoAP PUT resource"
	default "telemetry"

config COAP_SERVER_HOSTNAME
	string "CoAP server hostname"
	default "californium.eclipseprojects.io"

menuconfig COAP_DTLS
	bool "CoAP client with DTLS support"
	help
	  If y, use together with either overlay-mbedtls.conf or
	  overlay-offload-tls.conf.

if COAP_DTLS

config COAP_DTLS_PSK_IDENTITY
	string "DTLS Preshared Key Identity"
	default "n3526561061234690123456789abcdef"

config COAP_DTLS_PSK_SECRET
	string "DTLS Preshared Key Secret"
	default "000102030405060708090a0b0c0d0e0f"

config COAP_SECTAG
	int "Security tag in which to store PSK"
	default 1

endif

config COAP_SERVER_PORT
	int "CoAP server port"
	default 5684 if COAP_DTLS
	default 5683

module = APP
module-dep = LOG
module-str = Log level for sample
source "${ZEPHYR_BASE}/subsys/logging/Kconfig.template.log_config"
endmenu # Application sample

menu "Zephyr Kernel"
source "Kconfig.zephyr"
endmenu
```

## prj.conf
```kconfig
#
# Copyright (c) 2019 Nordic Semiconductor ASA
#
# SPDX-License-Identifier: LicenseRef-Nordic-5-Clause
#
# General config
CONFIG_HEAP_MEM_POOL_SIZE=8192
CONFIG_NEWLIB_LIBC=y

# Mbed TLS logs include %zu formatters, which are not handled by the nano
# version of newlib
CONFIG_NEWLIB_LIBC_NANO=n

# Main thread
CONFIG_MAIN_STACK_SIZE=4096
CONFIG_SYSTEM_WORKQUEUE_STACK_SIZE=3072

# Networking
CONFIG_NETWORKING=y
CONFIG_NET_NATIVE=y
CONFIG_NET_CONFIG_NEED_IPV6=n
CONFIG_NET_SOCKETS=y
CONFIG_NET_SOCKETS_POSIX_NAMES=y
CONFIG_NET_UDP=y
CONFIG_NET_TCP=y
CONFIG_NET_IPV6=n
CONFIG_NET_IPV4=y
CONFIG_NET_SOCKETS_POLL_MAX=4
CONFIG_NET_CONNECTION_MANAGER=y

CONFIG_NET_L2_ETHERNET=y
CONFIG_ETH_NATIVE_POSIX=y
CONFIG_ETH_NATIVE_POSIX_RANDOM_MAC=y

# Kernel options
CONFIG_MAIN_STACK_SIZE=2048
CONFIG_ENTROPY_GENERATOR=y
CONFIG_TEST_RANDOM_GENERATOR=y
CONFIG_FAKE_ENTROPY_NATIVE_POSIX=n
CONFIG_INIT_STACKS=y

CONFIG_DNS_RESOLVER=y
CONFIG_DNS_RESOLVER_MAX_SERVERS=1
CONFIG_DNS_SERVER_IP_ADDRESSES=y
CONFIG_DNS_SERVER1="192.0.2.2"

# The addresses are selected so that qemu<->qemu connectivity works ok.
# For linux<->qemu connectivity, create a new conf file and swap the
# addresses (so that peer address is ending to 2).
CONFIG_NET_CONFIG_SETTINGS=y
CONFIG_NET_CONFIG_MY_IPV4_ADDR="192.0.2.1"
#CONFIG_NET_CONFIG_PEER_IPV4_ADDR="192.0.2.2"
#CONFIG_NET_CONFIG_PEER_IPV4_ADDR="34.231.208.143"
CONFIG_NET_CONFIG_MY_IPV4_GW="192.0.2.2"

# CoAP
CONFIG_COAP=y
CONFIG_COAP_EXTENDED_OPTIONS_LEN=y

CONFIG_COAP_SERVER_HOSTNAME="californium.eclipseprojects.io"
```

## overlay-mbedtls.conf
```kconfig
#
# Copyright (c) 2022 Nordic Semiconductor ASA
#
# SPDX-License-Identifier: LicenseRef-Nordic-5-Clause
#
# General config
CONFIG_COAP_DTLS=y

# MbedTLS needs a larger stack for the system workqueue
CONFIG_MAIN_STACK_SIZE=3072
CONFIG_SYSTEM_WORKQUEUE_STACK_SIZE=3072
# MbedTLS needs a larger heap
CONFIG_HEAP_MEM_POOL_SIZE=16384

# Networking
CONFIG_NET_SOCKETS_SOCKOPT_TLS=y
CONFIG_NET_SOCKETS_TLS_MAX_CONTEXTS=4
CONFIG_NET_SOCKETS_TLS_SET_MAX_FRAGMENT_LENGTH=y
CONFIG_NET_SOCKETS_ENABLE_DTLS=y

# Select mbed TLS
CONFIG_MBEDTLS=y
CONFIG_MBEDTLS_TLS_VERSION_1_2=y
CONFIG_MBEDTLS_BUILTIN=y

CONFIG_BUILD_WITH_TFM=n

# MbedTLS changes
CONFIG_MBEDTLS_ENABLE_HEAP=y
CONFIG_MBEDTLS_HEAP_SIZE=10240
CONFIG_MBEDTLS_SSL_MAX_CONTENT_LEN=1500

# Customize the set of ciphers enabled to only that which is needed
CONFIG_MBEDTLS_CIPHER_CCM_ENABLED=y
CONFIG_MBEDTLS_CIPHER_ALL_ENABLED=n
CONFIG_MBEDTLS_CIPHER_AES_ENABLED=y
CONFIG_MBEDTLS_CIPHER_DES_ENABLED=n
CONFIG_MBEDTLS_MAC_ALL_ENABLED=n
CONFIG_MBEDTLS_ECP_ALL_ENABLED=n
# CONFIG_MBEDTLS_X509_LIBRARY=n
CONFIG_MBEDTLS_KEY_EXCHANGE_ALL_ENABLED=n
CONFIG_MBEDTLS_KEY_EXCHANGE_RSA_ENABLED=n
CONFIG_MBEDTLS_KEY_EXCHANGE_PSK_ENABLED=y

# DTLS-specific settings
CONFIG_MBEDTLS_DTLS=y
CONFIG_MBEDTLS_SSL_DTLS_CONNECTION_ID=y
CONFIG_MBEDTLS_SSL_EXTENDED_MASTER_SECRET=y
CONFIG_MBEDTLS_SERVER_NAME_INDICATION=y

CONFIG_TLS_CREDENTIALS=y

# CoAP
CONFIG_COAP_EXTENDED_OPTIONS_LEN=y
# configure the following to a CoAP server to which your PSK has already
# been provisioned:
CONFIG_COAP_SERVER_HOSTNAME="coap.us-east-1.amazonaws.com"

# Logging
CONFIG_MBEDTLS_DEBUG=y
CONFIG_MBEDTLS_DEBUG_LEVEL=3
```

## src/main.c
```c
/*
 * Copyright (c) 2019 Nordic Semiconductor ASA
 *
 * SPDX-License-Identifier: LicenseRef-Nordic-5-Clause
 */

#include <stdio.h>
#include <string.h>

#include <zephyr/kernel.h>
#include <zephyr/net/coap.h>
#include <zephyr/net/socket.h>
//#include <modem/lte_lc.h>
#include <zephyr/random/rand32.h>
//#include <nrf_socket.h>
//#include <nrf_modem_at.h>

#include <logging/log.h>
LOG_MODULE_REGISTER(app_coap_client, CONFIG_APP_LOG_LEVEL);

#define APP_COAP_SEND_INTERVAL_MS 3000
#define APP_COAP_INTERVAL_LIMIT 360
#define APP_COAP_MAX_MSG_LEN 1280
#define APP_COAP_VERSION 1

#define COAP_SERVER_HOSTNAME CONFIG_COAP_SERVER_HOSTNAME
// "coap.us-east-1.amazonaws.com"
// "34.231.208.143"

static int sock;
static struct pollfd fds;
static struct sockaddr_storage server;
static uint16_t next_token;

static uint8_t coap_buf[APP_COAP_MAX_MSG_LEN];

static struct connection_info
{
	uint8_t s4_addr[4];
	uint8_t d4_addr[4];
} connection_info;

int client_dtls_init(int sock);

/**@brief Resolves the configured hostname. */
static int server_resolve(void)
{
	int err;
	struct addrinfo *result;
	struct addrinfo hints = {
		.ai_family = AF_INET,
		.ai_socktype = SOCK_DGRAM
	};
	char ipv4_addr[NET_IPV4_ADDR_LEN];

	printk("Getting server IP address...\n");
	err = getaddrinfo(COAP_SERVER_HOSTNAME, NULL, &hints, &result);
	if (err != 0) {
		printk("ERROR: getaddrinfo failed %d\n", err);
		return -EIO;
	}

	if (result == NULL) {
		printk("ERROR: Address not found\n");
		return -ENOENT;
	}

	printk("Received address\n");

	/* IPv4 Address. */
	struct sockaddr_in *server4 = ((struct sockaddr_in *)&server);

	server4->sin_addr.s_addr =
		((struct sockaddr_in *)result->ai_addr)->sin_addr.s_addr;
	server4->sin_family = AF_INET;
	server4->sin_port = htons(CONFIG_COAP_SERVER_PORT);

	connection_info.s4_addr[0] = server4->sin_addr.s4_addr[0];
	connection_info.s4_addr[1] = server4->sin_addr.s4_addr[1];
	connection_info.s4_addr[2] = server4->sin_addr.s4_addr[2];
	connection_info.s4_addr[3] = server4->sin_addr.s4_addr[3];

	inet_ntop(AF_INET, &server4->sin_addr.s_addr, ipv4_addr,
		  sizeof(ipv4_addr));
	printk("IPv4 Address for %s:%u found %s\n",
	       COAP_SERVER_HOSTNAME, CONFIG_COAP_SERVER_PORT, ipv4_addr);

	/* Free the address. */
	freeaddrinfo(result);

	return 0;
}

/**@brief Initialize the CoAP client */
static int client_init(void)
{
	int err;

	LOG_DBG("Creating socket");
#if !defined(CONFIG_COAP_DTLS)
	sock = socket(AF_INET, SOCK_DGRAM, IPPROTO_UDP);
#else
//#if CONFIG_NET_SOCKETS_OFFLOAD_PRIORITY < CONFIG_NET_SOCKETS_TLS_PRIORITY
	sock = socket(AF_INET, SOCK_DGRAM, IPPROTO_DTLS_1_2);
//#else
//	sock = socket(AF_INET, SOCK_DGRAM | SOCK_NATIVE_TLS, IPPROTO_DTLS_1_2);
//#endif
#endif
	if (sock < 0) {
		printk("Failed to create CoAP socket: %d.\n", -errno);
		return -errno;
	}

#if defined(CONFIG_COAP_DTLS)
	err = client_dtls_init(sock);
	if (err) {
		return err;
	}
#endif
	err = connect(sock, (struct sockaddr *)&server,
		      sizeof(struct sockaddr_in));
	if (err < 0) {
		printk("Connect failed : %d\n", -errno);
		return -errno;
	} else {
		LOG_DBG("Connect succeeded.");
	}

	/* Initialize FDS, for poll. */
	fds.fd = sock;
	fds.events = POLLIN;

	/* Randomize token. */
	next_token = sys_rand32_get();

	return 0;
}

static int client_response(struct coap_packet *req)
{
	int err;
	struct coap_packet response;

	err = coap_ack_init(&response, req, coap_buf, sizeof(coap_buf), 0);
	if (err < 0) {
		printk("Failed to create CoAP response, %d\n", err);
		return err;
	}

	err = send(sock, response.data, response.offset, 0);
	if (err < 0) {
		printk("Failed to send CoAP response, %d\n", -errno);
		return -errno;
	}

	return 0;
}

/**@brief Handles responses from the remote CoAP server. */
static int client_handle_get_response(uint8_t *buf, int received)
{
	int err;
	struct coap_packet reply;
	const uint8_t *payload;
	uint16_t payload_len;
	uint8_t token[8];
	uint16_t token_len;
	uint8_t temp_buf[16] = {0};
	uint8_t type;

	err = coap_packet_parse(&reply, buf, received, NULL, 0);
	if (err < 0) {
		printk("Malformed response received: %d\n", err);
		return err;
	}

	payload = coap_packet_get_payload(&reply, &payload_len);
	token_len = coap_header_get_token(&reply, token);
	type = coap_header_get_type(&reply);

	if ((token_len != sizeof(next_token)) ||
	    (memcmp(&next_token, token, sizeof(next_token)) != 0)) {
		printk("Invalid token received: 0x%02x%02x, expected: 0x%04x\n",
		       token[1], token[0], next_token);
		return 0;
	}

	if (payload_len > 0) {
		snprintf(temp_buf, MIN(payload_len + 1, sizeof(temp_buf)), "%s", payload);
	} else {
		strcpy(temp_buf, "EMPTY");
	}

	printk("CoAP response: code: 0x%x, token 0x%02x%02x, payload: %s\n",
	       coap_header_get_code(&reply), token[1], token[0], temp_buf);

	if (type == COAP_TYPE_CON) {
		printk("Sending ACK\n");
		err = client_response(&reply);
	}
	return err;
}

/**@brief Send CoAP GET request. */
static int client_get_send(void)
{
	int err;
	struct coap_packet request;

	next_token++;

	err = coap_packet_init(&request, coap_buf, sizeof(coap_buf),
			       APP_COAP_VERSION, COAP_TYPE_CON,
			       sizeof(next_token), (uint8_t *)&next_token,
			       COAP_METHOD_GET, coap_next_id());
	if (err < 0) {
		printk("Failed to create CoAP request, %d\n", err);
		return err;
	}

	err = coap_packet_append_option(&request, COAP_OPTION_URI_PATH,
					(uint8_t *)CONFIG_COAP_GET_RESOURCE,
					strlen(CONFIG_COAP_GET_RESOURCE));
	if (err < 0) {
		printk("Failed to encode CoAP option, %d\n", err);
		return err;
	}

	err = send(sock, request.data, request.offset, 0);
	if (err < 0) {
		printk("Failed to send CoAP request, %d\n", errno);
		return -errno;
	}

	printk("CoAP request sent: token 0x%04x\n", next_token);

	return 0;
}

/**@brief Send CoAP PUT request. */
static int client_put_send(void)
{
	int err;
	struct coap_packet request;
	const char *payload = "deadbeef";

	next_token++;

	err = coap_packet_init(&request, coap_buf, sizeof(coap_buf),
			       APP_COAP_VERSION, COAP_TYPE_CON,
			       sizeof(next_token), (uint8_t *)&next_token,
			       COAP_METHOD_PUT, coap_next_id());
	if (err < 0) {
		printk("Failed to create CoAP request, %d\n", err);
		return err;
	}

	err = coap_packet_append_option(&request, COAP_OPTION_URI_PATH,
					(uint8_t *)CONFIG_COAP_PUT_RESOURCE,
					strlen(CONFIG_COAP_PUT_RESOURCE));
	if (err < 0) {
		printk("Failed to encode CoAP option, %d", err);
		return err;
	}

	err = coap_packet_append_payload_marker(&request);
	if (err < 0) {
		printk("Failed to add CoAP payload marker, %d", err);
		return err;
	}

	err = coap_packet_append_payload(&request, payload, strlen(payload));
	if (err < 0) {
		printk("Failed to add CoAP payload, %d", err);
		return err;
	}

	err = send(sock, request.data, request.offset, 0);
	if (err < 0) {
		printk("Failed to send CoAP request, %d", errno);
		return -errno;
	}

	printk("CoAP request sent: token 0x%04x\n", next_token);

	return 0;
}

/* Returns 0 if data is available.
 * Returns -EAGAIN if timeout occured and there is no data.
 * Returns other, negative error code in case of poll error.
 */
static int wait(int timeout)
{
	int ret = poll(&fds, 1, timeout);

	if (ret < 0) {
		printk("poll error: %d\n", errno);
		return -errno;
	}

	if (ret == 0) {
		/* Timeout. */
		return -EAGAIN;
	}

	if ((fds.revents & POLLERR) == POLLERR) {
		printk("wait: POLLERR\n");
		return -EIO;
	}

	if ((fds.revents & POLLNVAL) == POLLNVAL) {
		printk("wait: POLLNVAL\n");
		return -EBADF;
	}

	if ((fds.revents & POLLIN) != POLLIN) {
		return -EAGAIN;
	}

	return 0;
}

void main(void)
{
	int64_t next_msg_time = APP_COAP_SEND_INTERVAL_MS;
	int err;
	int received;
	bool do_send = false;

	printk("The nRF CoAP client sample started\n");

	if (server_resolve() != 0) {
		printk("Failed to resolve server name\n");
		return;
	}

	if (client_init() != 0) {
		printk("Failed to initialize CoAP client\n");
		return;
	}

	next_msg_time = k_uptime_get();

	while (1) {
		if (k_uptime_get() >= next_msg_time) {
			if (do_send) {
				printk("\nCalling client_put_send()\n");
				if (client_put_send() != 0) {
					printk("Failed to send PUT request, exit...\n");
					break;
				}
			} else {
				printk("\nCalling client_get_send()\n");
				if (client_get_send() != 0) {
					printk("Failed to send GET request, exit...\n");
					break;
				}
			}
			do_send = !do_send;
			next_msg_time += APP_COAP_SEND_INTERVAL_MS;
		}

		int64_t remaining = next_msg_time - k_uptime_get();

		if (remaining < 0) {
			remaining = 0;
		}

		err = wait(remaining);
		if (err < 0) {
			if (err == -EAGAIN) {
				continue;
			}

			printk("Poll error, exit...\n");
			break;
		}

		received = recv(sock, coap_buf, sizeof(coap_buf), MSG_DONTWAIT);
		if (received < 0) {
			if (errno == EAGAIN || errno == EWOULDBLOCK) {
				printk("socket EAGAIN\n");
				continue;
			} else {
				printk("Socket error, exit...\n");
				break;
			}
		}

		if (received == 0) {
			printk("Empty datagram\n");
			continue;
		}

		err = client_handle_get_response(coap_buf, received);
		if (err < 0) {
			printk("Invalid response, exit...\n");
			break;
		}
	}

	(void)close(sock);
}
```

## src/dtls.c
```c
/*
 * Copyright (c) 2022 Nordic Semiconductor ASA
 *
 * SPDX-License-Identifier: LicenseRef-Nordic-5-Clause
 */

#include <stdio.h>
#include <string.h>

#include <zephyr.h>
#include <net/coap.h>
#include <net/socket.h>
//#include <modem/lte_lc.h>
//#include <modem/modem_key_mgmt.h>
#if defined(CONFIG_MODEM_INFO)
#include <modem/modem_info.h>
#endif
#if defined(CONFIG_MBEDTLS)
#include <mbedtls/ssl.h>
#endif
#if defined(CONFIG_TLS_CREDENTIALS)
#include <net/tls_credentials.h>
#endif
//#include <nrf_socket.h>
//#include <nrf_modem_at.h>

#include <logging/log.h>
LOG_MODULE_DECLARE(app_coap_client, CONFIG_APP_LOG_LEVEL);

#define log_strdup(x) (x)

#if defined(CONFIG_MBEDTLS)
/* Uncomment to limit cipher negotation to a list */
#define RESTRICT_CIPHERS
/* Uncomment to display the cipherlist available */
/* #define DUMP_CIPHERLIST */
#endif

static sec_tag_t sectag = CONFIG_COAP_SECTAG;

#if defined(CONFIG_MODEM_INFO)
static struct modem_param_info mdm_param;
#endif

#if defined(CONFIG_MODEM_INFO)
static int get_device_ip_address(uint8_t *d4_addr)
{
	int err;

	err = modem_info_init();
	if (err) {
		printk("Could not init modem info: %d\n", err);
		return err;
	}
	err = modem_info_params_init(&mdm_param);
	if (err) {
		printk("Could not get modem info: %d\n", err);
		return err;
	}

	err = modem_info_params_get(&mdm_param);
	if (err) {
		printk("Could not get modem params: %d\n", err);
		return err;
	}
	LOG_DBG("nRF Connect SDK version: %s", mdm_param.device.app_version);
	LOG_DBG("Modem FW version:        %s", mdm_param.device.modem_fw.value_string);
	LOG_DBG("IMEI:                    %s", mdm_param.device.imei.value_string);

	err = inet_pton(AF_INET, mdm_param.network.ip_address.value_string, d4_addr);
	if (err == 1) {
		return 0;
	}
	return errno;
}
#endif /* CONFIG_MODEM_INFO */

int provision_psk(void)
{
	int ret;
	const char *identity = CONFIG_COAP_DTLS_PSK_IDENTITY;
	uint16_t identity_len;
	const char *psk = CONFIG_COAP_DTLS_PSK_SECRET;
	uint16_t psk_len;

	identity_len = strlen(identity);
	psk_len = strlen(psk);

	LOG_DBG("psk identity: %s len %u", log_strdup(identity), identity_len);
	LOG_HEXDUMP_DBG(psk, psk_len, "psk");

#if defined(CONFIG_NET_SOCKETS_OFFLOAD_TLS)
	char psk_hex[64];

	/* Convert PSK to a format accepted by the modem. */
	psk_len = bin2hex(psk, psk_len, psk_hex, sizeof(psk_hex));
	if (psk_len == 0) {
		printk("PSK is too large to convert (%d)\n", -EOVERFLOW);
		return -EOVERFLOW;
	}
	LOG_HEXDUMP_DBG(psk_hex, 64, "psk_hex\n");

	lte_lc_offline();

	ret = modem_key_mgmt_write(sectag, MODEM_KEY_MGMT_CRED_TYPE_PSK, psk_hex, psk_len);
	if (ret < 0) {
		printk("Setting cred tag %d type %d failed (%d)\n", sectag,
			(int)MODEM_KEY_MGMT_CRED_TYPE_PSK, ret);
		goto exit;
	}

	ret = modem_key_mgmt_write(sectag, MODEM_KEY_MGMT_CRED_TYPE_IDENTITY, identity,
				   identity_len);
	if (ret < 0) {
		printk("Setting cred tag %d type %d failed (%d)\n", sectag,
			(int)MODEM_KEY_MGMT_CRED_TYPE_IDENTITY, ret);
	}
exit:
	lte_lc_connect();
#else
	ret = tls_credential_add(sectag, TLS_CREDENTIAL_PSK, psk, psk_len);
	if (ret) {
		printk("Failed to set PSK: %d\n", ret);
	}
	ret = tls_credential_add(sectag, TLS_CREDENTIAL_PSK_ID, identity, identity_len);
	if (ret) {
		printk("Failed to set PSK identity: %d\n", ret);
	}
#endif /* CONFIG_NET_SOCKETS_OFFLOAD_TLS */
	return ret;
}

int client_dtls_init(int sock)
{
	int err;
#if defined(RESTRICT_CIPHERS)
	static const int ciphers[] = {
		MBEDTLS_TLS_PSK_WITH_AES_128_CCM_8, 0
	};
#endif

	printk("Provisioning PSK\n");
	err = provision_psk();
	if (err) {
		return err;
	}
	printk("Setting socket options\n");

	err = setsockopt(sock, SOL_TLS, TLS_HOSTNAME, CONFIG_COAP_SERVER_HOSTNAME,
			 sizeof(CONFIG_COAP_SERVER_HOSTNAME));
	if (err) {
		printk("Error setting hostname: %d\n", errno);
	}

	err = setsockopt(sock, SOL_TLS, TLS_SEC_TAG_LIST, &sectag, sizeof(sec_tag_t));
	if (err) {
		printk("Error setting sectag list: %d\n", errno);
	}

#if defined(RESTRICT_CIPHERS)
	err = setsockopt(sock, SOL_TLS, TLS_CIPHERSUITE_LIST, ciphers, sizeof(ciphers));
	if (err) {
		printk("Error setting cipherlist: %d\n", errno);
	}
#endif
#if defined(DUMP_CIPHERLIST)
	int len;
	int ciphers[32];

	len = sizeof(ciphers);
	err = getsockopt(sock, SOL_TLS, TLS_CIPHERSUITE_LIST, ciphers, &len);
	if (err) {
		printk("Error getting cipherlist: %d\n", errno);
	} else {
		int count = len / sizeof(int);

		printk("New cipherlist:\n");
		for (int i = 0; i < count; i++) {
			printk("%d. 0x%04X = %s\n", i, (unsigned int)ciphers[i],
			       mbedtls_ssl_get_ciphersuite_name(ciphers[i]));
		}
	}
#endif

#if defined(CONFIG_MODEM_INFO)
	uint8_t d4_addr[4];

	err = get_device_ip_address(d4_addr);
	if (err) {
		return err;
	}
	printk("client addr %u.%u.%u.%u\n", d4_addr[0], d4_addr[1], d4_addr[2], d4_addr[3]);
#endif
#if defined(CONFIG_MBEDTLS_SSL_DTLS_CONNECTION_ID)
	uint8_t dummy;

	err = setsockopt(sock, SOL_TLS, TLS_DTLS_CONNECTION_ID, &dummy, 0);
	if (err) {
		printk("Error setting connection ID: %d\n", errno);
	}
#endif
	return err;
}
```
